## external/package/sc_usb_tools/Config.in
```kconfig
config BR2_PACKAGE_SC_USB_TOOLS
	bool "ScUsbTools"
	default n
	help
	  Set of tools that seem to communicate through the USB.
	  They include and old SMB1, bftpd and dlna applications.
	  Can't see a need for them so I removed them.

	  If instead you want to include the package say yes here.

	  Most people should answer N.
```

## external/package/sec_kernel/Config.in
```kconfig
config BR2_PACKAGE_SEC_KERNEL
	bool "Sec_Kernel"
	default n
	help
	  This may be used during the firmware configuration after
	  an update. I'm not sure. I removed it but may put it back
	  when I'm in a position to test it further.

	  If instead you want to include the package say yes here.

	  Most people should answer N.
```

## external/package/sven/Config.in
```kconfig
config BR2_PACKAGE_SVEN
	bool "System Visible Event Nexus"
	select BR2_PACKAGE_SYSTEM_UTILS
	select BR2_PACKAGE_IOSF
	default n
	help
	  Files tagged:
	  lib/modules/sven_linux.ko lib/libomarwave.so lib/libhtuple.so lib/libsven.so bin/csven scripts/ bin/mcu_config bin/pci_query etc/rc3.d/sven etc/init.d/sven

	  Most people should answer N.
```

## external/package/system_utils/Config.in
```kconfig
config BR2_PACKAGE_SYSTEM_UTILS
	bool "System Utilities Module/Library"
	select BR2_PACKAGE_PLATFORM_CONFIG
	default n
	help
	  Kernel module and userpace library that provides
	  various system utilities.

	  System Utilities
	  ================
	  Files tagged:
	  $(find -name '*system_utils*')

	  Most people should answer N.
```

## external/package/thermal/Config.in
```kconfig
config BR2_PACKAGE_THERMAL
	bool "Thermal"
	default n
	help
	  Kernel module and tools that monitor the temperature of
	  the CPU. They are referenced in a few executables but 
	  don't seem to be executed. If this package isn't included
	  then scripts are linked that log attepted access to the
	  utilities. I have removed them by default.

	  If instead you want to include the package say yes here.

	  Most people should answer N.
```

## external/package/twister/Config.in
```kconfig
config BR2_PACKAGE_TWISTER
	bool "Twister"
	default n
	help
	  This is an unknown service which is unlikely to be needed
	  in my environment. It opens a few holes in the router so I
	  will remove it. Since there are two programs that can start
	  it I will replace the original scripts with fake ones that
	  just log the attempt to start and then exit.

	  If instead you want to include the package say yes here.

	  Most people should answer N.
```

## external/package/wdt/Config.in
```kconfig
config BR2_PACKAGE_WDT
	bool "Intel CE Watchdog Modules/Userspace"
	default n
	help
	  Kernel modules and userpace programs for
	  watchdog from the router.

	  Intel CE Watchdog
	  =================
	  Files tagged:
	  $(find . -regextype sed -regex ".*\(watchdog\|ce_wdt\).*" ! -regex "./sbin/.*")

	  Most people should answer N.
```

## external/package/xtables/Config.in
```kconfig
config BR2_PACKAGE_XTABLES
	bool "XTables"
	default n
	help
	  There seems to be something wrong. From my experience
	  iptables/xtables, etc are required and used all over
	  the place. But not in this image. Maybe they are in the
	  ARM side? I am using as an internal modem anyway so I
	  removed them.

	  If instead you want to include the package say yes here.

	  Most people should answer N.
```
