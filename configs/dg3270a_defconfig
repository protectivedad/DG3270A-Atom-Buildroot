## configs/dg3270a_defconfig
```kconfig
BR2_x86_atom=y
BR2_GLOBAL_PATCH_DIR="$(CONFIG_DIR)/board/arris/dg3270a/patches"
BR2_KERNEL_HEADERS_VERSION=y
BR2_DEFAULT_KERNEL_VERSION="2.6.39"
BR2_TOOLCHAIN_BUILDROOT_GLIBC=y
BR2_BINUTILS_VERSION_2_24=y
BR2_GCC_VERSION_4_5_X=y
BR2_TOOLCHAIN_BUILDROOT_CXX=y
BR2_ENABLE_LOCALE_PURGE=y
BR2_ENABLE_LOCALE_WHITELIST="C en_US"
BR2_PACKAGE_BUSYBOX_CONFIG="${CONFIG_DIR}/board/arris/dg3270a/busybox.config"
BR2_PACKAGE_STRACE=y
BR2_PACKAGE_HOSTAPD=y
BR2_PACKAGE_HOSTAPD_EAP=y
BR2_PACKAGE_HOSTAPD_WPS=y
BR2_PACKAGE_WPA_SUPPLICANT=y
BR2_PACKAGE_WPA_SUPPLICANT_EAP=y
BR2_PACKAGE_WPA_SUPPLICANT_HOTSPOT=y
BR2_PACKAGE_WPA_SUPPLICANT_DEBUG_SYSLOG=y
BR2_PACKAGE_WPA_SUPPLICANT_WPS=y
BR2_PACKAGE_WPA_SUPPLICANT_CLI=y
BR2_PACKAGE_WPA_SUPPLICANT_PASSPHRASE=y
BR2_TARGET_ROOTFS_SQUASHFS=y
BR2_TARGET_ROOTFS_SQUASHFS4_XZ=y
BR2_TARGET_ROOTFS_TAR_XZ=y
```

## external/Config.in
```kconfig
if BR2_PACKAGE_HOSTAPD

menu "Hostapd overrides"

config BR2_PACKAGE_HOSTAPD_QCA988X
	bool "Override Hostapd for Atheros QCA988x"
	default y
	help
	  This will override the Hostapd config options
	  to make Atheros the only driver available.

config BR2_PACKAGE_HOSTAPD_HIDEDEBUG
	bool "Disable DEBUG"
	default n
	help
	  Remove support standard debug messages.

endmenu

endif

if BR2_PACKAGE_WPA_SUPPLICANT

menu "WPA_Supplicant overrides"

config BR2_PACKAGE_WPA_SUPPLICANT_QCA988X
	bool "Override WPA_Supplicant w/only WEXT"
	default y
	help
	  This will override the WPA_Supplicant config
	  options to make WEXT the only driver available.

config BR2_PACKAGE_WPA_SUPPLICANT_HIDEDEBUG
	bool "Disable DEBUG"
	default n
	help
	  Remove support standard debug messages.

endmenu

endif

source "$BR2_EXTERNAL_DEFAULT_PATH/package/portmap/Config.in"
source "$BR2_EXTERNAL_DEFAULT_PATH/package/atheros/Config.in"
source "$BR2_EXTERNAL_DEFAULT_PATH/package/iproute2_bin/Config.in"
source "$BR2_EXTERNAL_DEFAULT_PATH/package/hnc/Config.in"
source "$BR2_EXTERNAL_DEFAULT_PATH/package/twister/Config.in"
source "$BR2_EXTERNAL_DEFAULT_PATH/package/xtables/Config.in"
source "$BR2_EXTERNAL_DEFAULT_PATH/package/sec_kernel/Config.in"
source "$BR2_EXTERNAL_DEFAULT_PATH/package/sc_usb_tools/Config.in"
source "$BR2_EXTERNAL_DEFAULT_PATH/package/thermal/Config.in"
source "$BR2_EXTERNAL_DEFAULT_PATH/package/old_udev/Config.in"
source "$BR2_EXTERNAL_DEFAULT_PATH/package/dibbler/Config.in"
source "$BR2_EXTERNAL_DEFAULT_PATH/package/pwm/Config.in"
source "$BR2_EXTERNAL_DEFAULT_PATH/package/punit_fw_upgrade/Config.in"
source "$BR2_EXTERNAL_DEFAULT_PATH/package/sven/Config.in"
source "$BR2_EXTERNAL_DEFAULT_PATH/package/dts/Config.in"
source "$BR2_EXTERNAL_DEFAULT_PATH/package/arris_clients/Config.in"
source "$BR2_EXTERNAL_DEFAULT_PATH/package/iosf/Config.in"
source "$BR2_EXTERNAL_DEFAULT_PATH/package/idl/Config.in"
source "$BR2_EXTERNAL_DEFAULT_PATH/package/intel_ce_pm/Config.in"
source "$BR2_EXTERNAL_DEFAULT_PATH/package/gpio/Config.in"
source "$BR2_EXTERNAL_DEFAULT_PATH/package/system_utils/Config.in"
source "$BR2_EXTERNAL_DEFAULT_PATH/package/devmem/Config.in"
source "$BR2_EXTERNAL_DEFAULT_PATH/package/platform_config/Config.in"
source "$BR2_EXTERNAL_DEFAULT_PATH/package/pal_osal/Config.in"
source "$BR2_EXTERNAL_DEFAULT_PATH/package/wdt/Config.in"
source "$BR2_EXTERNAL_DEFAULT_PATH/package/bootparams/Config.in"
```

## external/configs/buildroot_defconfig
```kconfig
BR2_x86_atom=y
BR2_DL_DIR="${PROJ_DL_DIR}"
BR2_PACKAGE_OVERRIDE_FILE="${BR2_EXTERNAL_DEFAULT_PATH}/local.mk"
BR2_GLOBAL_PATCH_DIR="${BR2_EXTERNAL_DEFAULT_PATH}/patches"
BR2_TOOLCHAIN_BUILDROOT_GLIBC=y
BR2_KERNEL_HEADERS_VERSION=y
BR2_DEFAULT_KERNEL_VERSION="2.6.39"
BR2_PACKAGE_HOST_LINUX_HEADERS_CUSTOM_REALLY_OLD=y
BR2_BINUTILS_VERSION_2_28_X=y
BR2_GCC_VERSION_6_X=y
BR2_TOOLCHAIN_BUILDROOT_CXX=y
BR2_GCC_ENABLE_LTO=y
BR2_GCC_ENABLE_GRAPHITE=y
BR2_TARGET_OPTIMIZATION="-pipe"
BR2_ROOTFS_DEVICE_CREATION_STATIC=y
BR2_TARGET_GENERIC_GETTY_PORT="ttyS0"
BR2_TARGET_GENERIC_GETTY_BAUDRATE_115200=y
BR2_ENABLE_LOCALE_WHITELIST="en_US"
BR2_ROOTFS_OVERLAY="${BR2_EXTERNAL_DEFAULT_PATH}/rootfs_overlay"
BR2_ROOTFS_POST_BUILD_SCRIPT="${BR2_EXTERNAL_DEFAULT_PATH}/post_build.sh"
BR2_ROOTFS_POST_IMAGE_SCRIPT="${BR2_EXTERNAL_DEFAULT_PATH}/post_image.sh"
BR2_LINUX_KERNEL=y
BR2_LINUX_KERNEL_CUSTOM_VERSION=y
BR2_LINUX_KERNEL_CUSTOM_VERSION_VALUE="2.6.39"
BR2_LINUX_KERNEL_USE_CUSTOM_CONFIG=y
BR2_LINUX_KERNEL_CUSTOM_CONFIG_FILE="${BR2_EXTERNAL_DEFAULT_PATH}/configs/linux_defconfig"
BR2_LINUX_KERNEL_XZ=y
BR2_PACKAGE_BUSYBOX_CONFIG="${BR2_EXTERNAL_DEFAULT_PATH}/configs/busybox_defconfig"
BR2_PACKAGE_STRACE=y
BR2_PACKAGE_E2FSPROGS=y
BR2_PACKAGE_E2FSPROGS_E4DEFRAG=y
BR2_PACKAGE_XFSPROGS=y
BR2_PACKAGE_OPENSSL=y
BR2_PACKAGE_OPENSSL_BIN=y
BR2_PACKAGE_SQLITE=y
BR2_PACKAGE_SQLITE_STAT3=y
BR2_PACKAGE_SQLITE_ENABLE_FTS3=y
BR2_PACKAGE_SQLITE_ENABLE_UNLOCK_NOTIFY=y
BR2_PACKAGE_LIBCURL=y
BR2_PACKAGE_READLINE=y
BR2_PACKAGE_DROPBEAR=y
# BR2_PACKAGE_DROPBEAR_CLIENT is not set
BR2_PACKAGE_DROPBEAR_DISABLE_REVERSEDNS=y
BR2_PACKAGE_HOSTAPD=y
BR2_PACKAGE_HOSTAPD_EAP=y
BR2_PACKAGE_HOSTAPD_WPS=y
BR2_PACKAGE_TCPDUMP=y
BR2_PACKAGE_WIRELESS_TOOLS_LIB=y
BR2_PACKAGE_WPA_SUPPLICANT=y
BR2_PACKAGE_WPA_SUPPLICANT_EAP=y
BR2_PACKAGE_WPA_SUPPLICANT_HOTSPOT=y
BR2_PACKAGE_WPA_SUPPLICANT_DEBUG_SYSLOG=y
BR2_PACKAGE_WPA_SUPPLICANT_WPS=y
BR2_PACKAGE_WPA_SUPPLICANT_CLI=y
BR2_PACKAGE_WPA_SUPPLICANT_PASSPHRASE=y
BR2_PACKAGE_ATTR=y
BR2_TARGET_ROOTFS_SQUASHFS=y
BR2_TARGET_ROOTFS_SQUASHFS4_XZ=y
BR2_TARGET_ROOTFS_TAR_XZ=y
BR2_PACKAGE_PORTMAP=y
```

## external/configs/dg3270a_defconfig
```kconfig
BR2_x86_atom=y
BR2_DL_DIR="${PROJ_DL_DIR}"
BR2_PACKAGE_OVERRIDE_FILE="${BR2_EXTERNAL}/local.mk"
BR2_GLOBAL_PATCH_DIR="${BR2_EXTERNAL}/patches"
BR2_KERNEL_HEADERS_VERSION=y
BR2_DEFAULT_KERNEL_VERSION="2.6.39"
BR2_TOOLCHAIN_BUILDROOT_GLIBC=y
BR2_BINUTILS_VERSION_2_25_X=y
BR2_GCC_VERSION_4_7_X=y
BR2_TOOLCHAIN_BUILDROOT_CXX=y
BR2_ENABLE_LOCALE_PURGE=y
BR2_ENABLE_LOCALE_WHITELIST="en_US"
BR2_TARGET_OPTIMIZATION="-pipe"
BR2_ROOTFS_DEVICE_CREATION_STATIC=y
BR2_TARGET_GENERIC_GETTY_PORT="ttyS0"
BR2_TARGET_GENERIC_GETTY_BAUDRATE_115200=y
BR2_ROOTFS_OVERLAY="${BR2_EXTERNAL}/rootfs_overlay"
BR2_ROOTFS_POST_BUILD_SCRIPT="${BR2_EXTERNAL}/post_build.sh"
BR2_PACKAGE_BUSYBOX_CONFIG="${BR2_EXTERNAL}/package/busybox/busybox.config"
BR2_PACKAGE_STRACE=y
BR2_PACKAGE_OPENSSL=y
BR2_PACKAGE_OPENSSL_BIN=y
BR2_PACKAGE_SQLITE=y
BR2_PACKAGE_SQLITE_READLINE=y
BR2_PACKAGE_SQLITE_STAT3=y
BR2_PACKAGE_SQLITE_ENABLE_FTS3=y
BR2_PACKAGE_SQLITE_ENABLE_UNLOCK_NOTIFY=y
BR2_PACKAGE_DROPBEAR=y
# BR2_PACKAGE_DROPBEAR_CLIENT is not set
BR2_PACKAGE_DROPBEAR_DISABLE_REVERSEDNS=y
BR2_PACKAGE_HOSTAPD=y
BR2_PACKAGE_HOSTAPD_EAP=y
BR2_PACKAGE_HOSTAPD_WPS=y
BR2_PACKAGE_TCPDUMP=y
BR2_PACKAGE_WPA_SUPPLICANT=y
BR2_PACKAGE_WPA_SUPPLICANT_EAP=y
BR2_PACKAGE_WPA_SUPPLICANT_HOTSPOT=y
BR2_PACKAGE_WPA_SUPPLICANT_DEBUG_SYSLOG=y
BR2_PACKAGE_WPA_SUPPLICANT_WPS=y
BR2_PACKAGE_WPA_SUPPLICANT_CLI=y
BR2_PACKAGE_WPA_SUPPLICANT_PASSPHRASE=y
BR2_TARGET_ROOTFS_SQUASHFS=y
BR2_TARGET_ROOTFS_SQUASHFS4_XZ=y
BR2_TARGET_ROOTFS_TAR_XZ=y
BR2_DEFCONFIG="${BR2_EXTERNAL}/configs/dg3270a_defconfig"
```

## external/configs/lto_defconfig
```kconfig
BR2_x86_atom=y
BR2_DL_DIR="${PROJ_DL_DIR}"
BR2_PACKAGE_OVERRIDE_FILE="${BR2_EXTERNAL_DEFAULT_PATH}/local.mk"
BR2_GLOBAL_PATCH_DIR="${BR2_EXTERNAL_DEFAULT_PATH}/patches"
BR2_TOOLCHAIN_EXTERNAL=y
BR2_TOOLCHAIN_EXTERNAL_PATH="${PROJ_TC_DIR}/usr"
BR2_TOOLCHAIN_EXTERNAL_GCC_7=y
BR2_TOOLCHAIN_EXTERNAL_CUSTOM_GLIBC=y
BR2_TOOLCHAIN_EXTERNAL_CXX=y
BR2_TARGET_OPTIMIZATION="-pipe -flto=3 -fgraphite-identity -floop-nest-optimize -ftree-loop-distribution -ftree-vectorize"
BR2_TARGET_LDFLAGS="-pipe -Os -flto=3 -fgraphite-identity -floop-nest-optimize -ftree-loop-distribution -ftree-vectorize"
BR2_ROOTFS_DEVICE_CREATION_STATIC=y
BR2_TARGET_GENERIC_GETTY_PORT="ttyS0"
BR2_TARGET_GENERIC_GETTY_BAUDRATE_115200=y
BR2_ENABLE_LOCALE_WHITELIST="en_US"
BR2_ROOTFS_OVERLAY="${BR2_EXTERNAL_DEFAULT_PATH}/rootfs_overlay"
BR2_ROOTFS_POST_BUILD_SCRIPT="${BR2_EXTERNAL_DEFAULT_PATH}/post_build.sh"
BR2_ROOTFS_POST_IMAGE_SCRIPT="${BR2_EXTERNAL_DEFAULT_PATH}/post_image.sh"
BR2_PACKAGE_BUSYBOX_CONFIG="${BR2_EXTERNAL_DEFAULT_PATH}/configs/busybox_defconfig"
BR2_PACKAGE_KEXEC=y
BR2_PACKAGE_KEXEC_ZLIB=y
BR2_PACKAGE_STRACE=y
BR2_PACKAGE_E2FSPROGS=y
BR2_PACKAGE_E2FSPROGS_E4DEFRAG=y
BR2_PACKAGE_OPENSSL=y
BR2_PACKAGE_LIBOPENSSL_BIN=y
BR2_PACKAGE_LIBCURL=y
BR2_PACKAGE_READLINE=y
BR2_PACKAGE_DROPBEAR=y
# BR2_PACKAGE_DROPBEAR_CLIENT is not set
BR2_PACKAGE_DROPBEAR_DISABLE_REVERSEDNS=y
BR2_PACKAGE_HOSTAPD=y
BR2_PACKAGE_HOSTAPD_EAP=y
BR2_PACKAGE_HOSTAPD_WPS=y
BR2_PACKAGE_RPCBIND=y
BR2_PACKAGE_TCPDUMP=y
BR2_PACKAGE_WIRELESS_TOOLS_LIB=y
BR2_PACKAGE_WPA_SUPPLICANT=y
BR2_PACKAGE_WPA_SUPPLICANT_EAP=y
BR2_PACKAGE_WPA_SUPPLICANT_HOTSPOT=y
BR2_PACKAGE_WPA_SUPPLICANT_DEBUG_SYSLOG=y
BR2_PACKAGE_WPA_SUPPLICANT_WPS=y
BR2_PACKAGE_WPA_SUPPLICANT_CLI=y
BR2_PACKAGE_WPA_SUPPLICANT_PASSPHRASE=y
BR2_PACKAGE_ATTR=y
BR2_TARGET_ROOTFS_SQUASHFS=y
BR2_TARGET_ROOTFS_SQUASHFS4_XZ=y
```

## external/configs/nonlto_defconfig
```kconfig
BR2_SYSTEM_BIN_SH_NONE=y
BR2_INIT_NONE=y
BR2_x86_atom=y
BR2_DL_DIR="${PROJ_DL_DIR}"
BR2_PACKAGE_OVERRIDE_FILE="${BR2_EXTERNAL_DEFAULT_PATH}/local.mk"
BR2_GLOBAL_PATCH_DIR="${BR2_EXTERNAL_DEFAULT_PATH}/patches"
BR2_TOOLCHAIN_EXTERNAL=y
BR2_TOOLCHAIN_EXTERNAL_CUSTOM=y
BR2_TOOLCHAIN_EXTERNAL_PATH="${PROJ_TC_DIR}/usr"
BR2_TOOLCHAIN_EXTERNAL_GCC_6=y
BR2_TOOLCHAIN_EXTERNAL_CUSTOM_GLIBC=y
BR2_TOOLCHAIN_EXTERNAL_CXX=y
BR2_TARGET_OPTIMIZATION="-pipe"
BR2_ROOTFS_DEVICE_CREATION_STATIC=y
BR2_TARGET_GENERIC_GETTY_PORT="ttyS0"
BR2_TARGET_GENERIC_GETTY_BAUDRATE_115200=y
BR2_ENABLE_LOCALE_WHITELIST="en_US"
BR2_LINUX_KERNEL=y
BR2_LINUX_KERNEL_CUSTOM_VERSION=y
BR2_LINUX_KERNEL_CUSTOM_VERSION_VALUE="2.6.39"
BR2_LINUX_KERNEL_USE_CUSTOM_CONFIG=y
BR2_LINUX_KERNEL_CUSTOM_CONFIG_FILE="${BR2_EXTERNAL_DEFAULT_PATH}/configs/linux_defconfig"
BR2_LINUX_KERNEL_XZ=y
# BR2_PACKAGE_BUSYBOX is not set
# BR2_TARGET_ROOTFS_TAR is not set
# BR2_PACKAGE_ATHEROS is not set
# BR2_PACKAGE_OLD_UDEV is not set
# BR2_PACKAGE_GPIO is not set
# BR2_PACKAGE_PAL_OSAL is not set
```

## external/configs/toolchain_defconfig
```kconfig
BR2_SYSTEM_BIN_SH_NONE=y
BR2_INIT_NONE=y
BR2_x86_atom=y
BR2_DL_DIR="${PROJ_DL_DIR}"
BR2_PACKAGE_OVERRIDE_FILE="${BR2_EXTERNAL_DEFAULT_PATH}/local.mk"
BR2_GLOBAL_PATCH_DIR="${BR2_EXTERNAL_DEFAULT_PATH}/patches"
BR2_HOST_DIR="${PROJ_DIR}/toolchain"
BR2_TOOLCHAIN_BUILDROOT_GLIBC=y
BR2_KERNEL_HEADERS_VERSION=y
BR2_DEFAULT_KERNEL_VERSION="2.6.39"
BR2_PACKAGE_HOST_LINUX_HEADERS_CUSTOM_REALLY_OLD=y
BR2_BINUTILS_VERSION_2_28_X=y
BR2_GCC_VERSION_6_X=y
BR2_TOOLCHAIN_BUILDROOT_CXX=y
BR2_GCC_ENABLE_LTO=y
BR2_GCC_ENABLE_GRAPHITE=y
BR2_TARGET_OPTIMIZATION="-pipe"
BR2_ROOTFS_DEVICE_CREATION_STATIC=y
BR2_TARGET_GENERIC_GETTY_PORT="ttyS0"
BR2_TARGET_GENERIC_GETTY_BAUDRATE_115200=y
BR2_ENABLE_LOCALE_WHITELIST="en_US"
# BR2_PACKAGE_BUSYBOX is not set
# BR2_TARGET_ROOTFS_TAR is not set
# BR2_PACKAGE_ATHEROS is not set
# BR2_PACKAGE_OLD_UDEV is not set
# BR2_PACKAGE_GPIO is not set
# BR2_PACKAGE_PAL_OSAL is not set
```

## external/package/arris_clients/Config.in
```kconfig
config BR2_PACKAGE_ARRIS_CLIENTS
	bool "Misc CLI files"
	default n
	help
	  Binaries of the various _cli executables that give
	  remote and local access to the router. I use ssh so
	  these have been removed.

	  If instead you want to include the package say yes here.

	  Most people should answer N.
```

## external/package/arris_event/Config.in
```kconfig
config BR2_PACKAGE_ARRIS_EVENT
	bool "Arris Event"
	default n
	help
	  Event daemon and kernel module.

	  Files tagged:
	  find -name '*event*' ! -name '*lib*'
	  
	  Most people should answer N.
```

## external/package/atheros/Config.in
```kconfig
config BR2_PACKAGE_ATHEROS
	bool "Atheros Wifi"
	select BR2_PACKAGE_WIRELESS_TOOLS
	default y
	help
	  Binaries and scripts to run the Atheros
	  wifi.
	  Atheros Wifi
	  uses: iwconfig

	  Files tagged:
	  Atheros Scripts
	  ./etc/ath
	  ./etc/rc.d/rc.wlan
	  Atheros Kernel Modules
	  ./lib/modules/2.6.39/net
	  Atheros Firmware
	  ./lib/firmware/AR9888
	  Atheros Tools and Libraries
	   libhyficommon.so libwpa_client.so
	   80211stats apstats athadhoc athdiag athstats athstatsclr
	   cfg lbd lbt pktlogconf pktlogdump radartool spectraltool
	   tx99tool_bin wifitool wlanconfig wnm-app radstat wps_gpio

	  Most people should answer Y.
```

## external/package/bootparams/Config.in
```kconfig
config BR2_PACKAGE_BOOTPARAMS
	bool "Intel CE Bootparams Module"
	default n
	help
	  Kernel module that creates a /proc/bootparams
	  file with various information in it.

	  Core bootparams
	  ===============
	  Files tagged:
	  $(find . -regextype sed -regex ".*bootparams.*" ! -regex "./sbin/.*")	  Intel CE Watchdog

	  Most people should answer N.
```

## external/package/devmem/Config.in
```kconfig
config BR2_PACKAGE_DEVMEM
	bool "DEVMEM Device Driver"
	select BR2_PACKAGE_PLATFORM_CONFIG
	default n
	help
	  Kernel module that creates a /dev/devmem.

	  DEVMEM Device Driver
	  ====================
	  provides devh_* symbols
	  Files tagged:
	  $(find -name '*devmem*')

	  Most people should answer N.
```

## external/package/dibbler/Config.in
```kconfig
config BR2_PACKAGE_DIBBLER
	bool "Dibbler DHCPv6"
	default n
	help
	  Binaries of the dibbler installed on the router. I may
	  switch over to the source code if I use it. It can be
	  found at: http://klub.com.pl/dhcpv6/.

	  Since I've removed it, it is not an issure.

	  If instead you want to include the package say yes here.

	  Most people should answer N.
```

## external/package/dts/Config.in
```kconfig
config BR2_PACKAGE_DTS
	bool "Intel CE Diagnostic Test Suite"
	select BR2_PACKAGE_PAL_OSAL
	select BR2_PACKAGE_DEVMEM
	default n
	help
	  Suite of tools to upgrade and get information
	  on the current firmware.

	  Files tagged:
	  /usr/dtsbin

	  Most people should answer N.
```

## external/package/gpio/Config.in
```kconfig
config BR2_PACKAGE_GPIO
	bool "IDL GPIO Modules/Userspace"
	select BR2_PACKAGE_PAL_OSAL
	default y
	help
	  Kernel modules and tools for the IDL GPIO. They are
	  used by arris_wlan_rpc_server and until I can get
	  rid of it they must be installed for a smooth start.
	  Note they do not require IDL to be installed in fact
	  IDL requires them. Includes WPS_GPIO for now.

	  IDL GPIO
	  ========
	  Files tagged:
	  $(find -name '*gpio*')

	  Most people should answer Y.
```

## external/package/hnc/Config.in
```kconfig
config BR2_PACKAGE_HNC
	bool "Arris HNC"
	default n
	help
	  HNC
	  ===
	  Files tagged:
	  $(egrep -Rl 'libacm|libhnc|HncInit|rpc_hnc|hnc_rpc' . 2>/dev/null) ./usr/sbin/config

	  Most people should answer N.
```

## external/package/idl/Config.in
```kconfig
config BR2_PACKAGE_IDL
	bool "IDL"
	select BR2_PACKAGE_GPIO
	select BR2_PACKAGE_PAL_OSAL
	default n
	help
	  IDL

	  Files tagged:
	  $(find . -regextype sed -regex ".*\(spi\|i2c\|idl\).*" ! -regex ".*gpio.*" ! -regex "./dev.*" ! -regex "./usr/sbin/.*")

	  Most people should answer N.
```

## external/package/intel_ce_pm/Config.in
```kconfig
config BR2_PACKAGE_INTEL_CE_PM
	bool "Intel CE Power Management"
	default n
	help
	  Binaries and scripots of the various power management
	  tools that seem to deal primarily with hardware not
	  found on the CE2600 so these have been removed.

	  If instead you want to include the package say yes here.

	  Most people should answer N.
```

## external/package/iosf/Config.in
```kconfig
config BR2_PACKAGE_IOSF
	bool "Intel CE IOSF Module"
	default n
	help
	  Kernel module with unknown purpose.

	  IOSF
	  ====
	  Files tagged:
	  $(find -name '*iosf*')
	  iosf - provides iosf_* symbols

	  Most people should answer N.
```

## external/package/iproute2_bin/Config.in
```kconfig
config BR2_PACKAGE_IPROUTE2_BIN
	bool "IPROUTE2 Binary Files"
	default n
	help
	  Files tagged:
	  $(fgrep -Rl 'iproute2-ss|041002' 2>/dev/null) ./usr/lib/tc ./sbin/ifcfg ./sbin/routef ./sbin/routel ./sbin/rtpr

	  Most people should answer N.
```
