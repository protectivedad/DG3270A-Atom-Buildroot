## external/package/old_udev/Config.in
```kconfig
config BR2_PACKAGE_OLD_UDEV
	bool "UDev"
	default y
	help
	  Old udev 175 package
```

## external/package/pal_osal/Config.in
```kconfig
config BR2_PACKAGE_PAL_OSAL
	bool "Abstraction Layers"
	default y
	help
	  Kernel modules and tools for the abstraction layers. They
	  are used by almost all the scripts and packages for
	  comminucating with the platform and OS.

	  Abstraction Layers
	  ==================
	  osal - Operating System Abstraction Layer - provide os_* symbols
	  pal - Platform Abstraction Layer - provides pal_* symbols

	  Files tagged:
	  $((find -name '*osal*'; find -name '*pal*'; find -name 'get_*') | sort -u)

	  Most people should answer Y.
```

## external/package/platform_config/Config.in
```kconfig
config BR2_PACKAGE_PLATFORM_CONFIG
	bool "Platform Configuration Device Driver"
	select BR2_PACKAGE_PAL_OSAL
	default n
	help
	  Required for updating emmc through the utilities.
	  Otherwise unneeded and may allow remote over writing.

	  Platform Config
	  ===============
	   ->Abstraction Layers
	  platform_config - Platform Configuration Device Driver - provides config_* symbols
	  Files tagged:
	  $(find -name '*platform_config*') ./bin/config_pmrs

	  Most people should answer N.
```

## external/package/punit_fw_upgrade/Config.in
```kconfig
config BR2_PACKAGE_BOOTPARAMS
	bool "Kernel Module to Upgrade P-Unit Firmware"
	select BR2_PACKAGE_IOSF
	select BR2_PACKAGE_PAL_OSAL
	select BR2_PACKAGE_DTS
	default n
	help
	  Kernel Module to Upgrade P-Unit Firmware.

	  Files tagged:
	  $(find -name '*punit*')

	  Most people should answer N.
```

## external/package/pwm/Config.in
```kconfig
config BR2_PACKAGE_BOOTPARAMS
	bool "PWM Device Driver"
	default n
	help
	  Kernel module.

	  Files tagged:
	  $(find -name '*pwm*')

	  Most people should answer N.
```
